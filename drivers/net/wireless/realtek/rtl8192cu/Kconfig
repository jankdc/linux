## drivers/net/wireless/realtek/rtl8192cu/Kconfig
```kconfig
config RTL8192CU
	tristate "Realtek 8192C USB WiFi"
	select WIRELESS_EXT
	depends on USB
	---help---
	  Help message of RTL8192CU
```

## drivers/net/wireless/realtek/rtl8192eu/Kconfig
```kconfig
config RTL8192EU
	tristate "Realtek 8192E USB WiFi"
	depends on USB
	select WIRELESS_EXT
	---help---
	  Help message of RTL8192EU
```
